## configs/REL_defconfig
```kconfig
CONFIG_APP_ADDRESS=0x41e1bc2c
CONFIG_APP_CALLER=0x41e19a78
CONFIG_BOOTLOADER_BASE=0x41E00000
CONFIG_BOOTLOADER_SIZE=0x550A4
CONFIG_BOOTMODE_ADDRESS=0x41E5A414
CONFIG_FASTBOOT_FAIL_ADDRESS=0x41e1c5c8
CONFIG_FASTBOOT_INFO_ADDRESS=0x41e1c57c
CONFIG_FASTBOOT_OKAY_ADDRESS=0x41E1C794
CONFIG_FASTBOOT_PUBLISH_ADDRESS=0x41E1C32C
CONFIG_FASTBOOT_REGISTER_ADDRESS=0x41E1C2F0
CONFIG_LK_LOG_STORE=n
CONFIG_MTK_DETECT_KEY_ADDRESS=0x41e041cc
CONFIG_PLATFORM_INIT_ADDRESS=0x41e01314
CONFIG_PLATFORM_INIT_CALLER=0x41e18cf4
CONFIG_VIDEO_PRINTF_ADDRESS=0x41E20EB8
CONFIG_DUPE_REL=y
CONFIG_MEDIATEK_MT6753=y

#just a guess as i dont want to solder UART probes on my device
CONFIG_UART_REG0=0x11002014
CONFIG_UART_REG1=0x11002000
```
